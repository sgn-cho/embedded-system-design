## src/components/temperature/Kconfig
```kconfig
menu "Temperature sensor config"
    config MEASUREMENT_INTERVAL
        int "Measurement interval"
        default 10000
        help
          Measurement interval in milliseconds

    config MEASUREMENT_OFFSET
        int "Measurement offset"
        default 0
        help
          Measurement offset in milliseconds
endmenu
```

## src/components/wifi/Kconfig
```kconfig
menu "Wi-Fi Connect Configuration"

    config WIFI_SSID
        string "WiFi SSID"
        default "myssid"
        help
            SSID (network name) for the example to connect to.

    config WIFI_PASSWORD
        string "WiFi Password"
        default "mypassword"
        help
            WiFi password (WPA or WPA2) for the example to use.

    choice ESP_WIFI_SAE_MODE
        prompt "WPA3 SAE mode selection"
        default ESP_WPA3_SAE_PWE_BOTH
        help
            Select mode for SAE as Hunt and Peck, H2E or both.
        config ESP_WPA3_SAE_PWE_HUNT_AND_PECK
            bool "HUNT AND PECK"
        config ESP_WPA3_SAE_PWE_HASH_TO_ELEMENT
            bool "H2E"
        config ESP_WPA3_SAE_PWE_BOTH
            bool "BOTH"
    endchoice

    config ESP_MAXIMUM_RETRY
        int "Maximum retry"
        default 5
        help
            Set the Maximum retry to avoid station reconnecting to the AP unlimited when the AP is really inexistent.

endmenu
```

## src/esp32/components/sys/Kconfig
```kconfig
menu "System Initializations"

    config ENABLE_TEMPERATURE_SENSOR
        bool "Enable Temperature Sensor"
        default y
        help
          Enable temperature sensor

    config ENABLE_CAMERA
        bool "Enable Camera"
        default y
        help
          Enable camera
    
    config ENABLE_SOIL_MOISTURE_SENSOR
        bool "Enable Soil Moisture Sensor"
        default y
        help
          Enable soil moisture sensor

endmenu
```

## src/esp32/main/Kconfig
```kconfig
menu "Experimental features"

    config TEST_WIFI_AP
        bool "Test WiFi AP"
        default n
        help
            Test WiFi AP

    config TEST_MQTT5
        bool "Test MQTT5"
        default n
        help
            Test MQTT5

    config TEST_DEEP_LEARNING
        bool "Test Deep Learning"
        default n
        help
            Test Deep Learning
endmenu
menu "Experimental Flag"
    
    config FLAG_TEST_WIFI_CSI
        bool "Test WiFi CSI"
        default f
        help
            Flag for Wi-Fi CSI functionality test

endmenu
```

## src/stargazer/components/system/Kconfig
```kconfig
menu "System component configuration"

    config ENABLE_TEMPERATURE_SENSOR
        bool "Enable temperature sensor"
        default y
        help
            Enable temperature sensor
        
    config ENABLE_SOIL_MOISTURE_SENSOR
        bool "Enable soil moisture sensor"
        default y
        help
            Enable soil moisture sensor
    
endmenu
```
